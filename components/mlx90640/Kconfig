## components/mlx90640/Kconfig
```kconfig
menu "Thermal Sensor Driver Configuration"

    choice THERMAL_SENSOR_MODEL_CHOICE
        prompt "Thermal Sensor Chip Support"
        default THERMAL_SENSOR_RUNTIME
        help
            Select which Melexis IR array driver(s) to compile into firmware.
            "Runtime selectable" compiles both MLX90641 and MLX90640 and lets
            config.json (sensor.model) select the active chip at boot.

        config THERMAL_SENSOR_RUNTIME
            bool "Runtime selectable (MLX90641 + MLX90640)"

        config THERMAL_SENSOR_ONLY_MLX90641
            bool "MLX90641 only (16x12)"

        config THERMAL_SENSOR_ONLY_MLX90640
            bool "MLX90640 only (32x24)"
    endchoice

    choice THERMAL_SENSOR_DEFAULT_MODEL
        prompt "Default Sensor Model"
        default THERMAL_SENSOR_DEFAULT_MLX90641 if !THERMAL_SENSOR_ONLY_MLX90640
        default THERMAL_SENSOR_DEFAULT_MLX90640 if THERMAL_SENSOR_ONLY_MLX90640

        config THERMAL_SENSOR_DEFAULT_MLX90641
            bool "MLX90641 (16x12)"
            depends on !THERMAL_SENSOR_ONLY_MLX90640

        config THERMAL_SENSOR_DEFAULT_MLX90640
            bool "MLX90640 (32x24)"
            depends on !THERMAL_SENSOR_ONLY_MLX90641
    endchoice

endmenu
```

## sdkconfig.defaults
```kconfig
# Target
CONFIG_IDF_TARGET="esp32s3"

# Flash 16MB
CONFIG_ESPTOOLPY_FLASHSIZE_16MB=y
CONFIG_ESPTOOLPY_FLASHSIZE="16MB"

# Custom Partition Table
CONFIG_PARTITION_TABLE_CUSTOM=y
CONFIG_PARTITION_TABLE_CUSTOM_FILENAME="partitions.csv"
CONFIG_PARTITION_TABLE_FILENAME="partitions.csv"

# PSRAM / SPIRAM (8MB Octal)
CONFIG_SPIRAM=y
CONFIG_SPIRAM_MODE_OCT=y
CONFIG_SPIRAM_SPEED_80M=y
CONFIG_SPIRAM_BOOT_INIT=y
CONFIG_SPIRAM_USE_MALLOC=y

# USB Serial/JTAG console
CONFIG_ESP_CONSOLE_USB_SERIAL_JTAG=y

# Main Task Stack Size
CONFIG_ESP_MAIN_TASK_STACK_SIZE=16384

# HTTP Server WebSocket Support
CONFIG_HTTPD_WS_SUPPORT=y
CONFIG_HTTPD_WS_POST_HANDSHAKE_CB_SUPPORT=y
CONFIG_LWIP_MAX_SOCKETS=16

# Thermal Sensor Configuration
CONFIG_THERMAL_SENSOR_RUNTIME=y
CONFIG_THERMAL_SENSOR_DEFAULT_MLX90641=y
```
